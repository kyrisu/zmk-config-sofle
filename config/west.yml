## config/west.yml
```yaml
manifest:
  remotes:
    - name: zmkfirmware
      url-base: https://github.com/zmkfirmware
    - name: kyrisu
      url-base: https://github.com/kyrisu
  projects:
    - name: zmk
      remote: kyrisu
      revision: sofle
      import: app/west.yml
  self:
    path: config
```
